## platforms/esp-idf/main/Kconfig.projbuild
```kconfig
menu "Board Selection"

    choice EXAMPLE_SDMMC_BUS_WIDTH
        prompt "Choose your board"
        default ESP32_S3_CAM_BOARD
        help
            ESP32F_BOARD: No PSRAM, use SPI mode for SD card
            ESP32_CAM_BOARD: With PSRAM, use SDIO mode for SD card
            ESP32_S3_CAM_BOARD: ESP32-S3 with PSRAM, use SDIO mode for SD card

        config ESP32F_BOARD
            bool "ESP32F_BOARD"

        config ESP32_CAM_BOARD
            bool "ESP32_CAM_BOARD"
            select SPIRAM
            select SPIRAM_BOOT_INIT
            select SPIRAM_IGNORE_NOTFOUND

        config ESP32_S3_CAM_BOARD
            bool "ESP32_S3_CAM_BOARD"
            select SPIRAM
            select SPIRAM_BOOT_INIT
            select SPIRAM_IGNORE_NOTFOUND
    endchoice
endmenu

menu "LiME-TM: Lightning fast and Memory Efficient Machine Learning for MCU (Tsetlin Machine)"
    choice
        prompt "Choose exmaple"
    
        config LIME_TM_USING_MNIST_FS_EXAMPLE
            bool "Training and testing MNIST example (File System)"
            select TSETLIN_USING_PROTOBUF
            help
                Training a compressed Tsetlin Machine model on the MNIST dataset.
    
        config LIME_TM_USING_MNIST_STATIC_EXAMPLE
            bool "Training and testing MNIST example (Static Model)"
            select TSETLIN_USING_STATIC_MODEL
            help
                Training a compressed Tsetlin Machine model on the MNIST dataset.
    endchoice
    
    config TSETLIN_USING_PROTOBUF
        bool "Load model from protobuf file"
        help
            Using proto-c to save the model as a protobuf file.
        depends on LIME_TM_USING_MNIST_FS_EXAMPLE
        default y
    
    config TSETLIN_USING_STATIC_MODEL
        bool "Load model from static headers"
        help
            Using the tsetlin compiler to save the model as a static C header file.
        depends on LIME_TM_USING_MNIST_STATIC_EXAMPLE
        default y
endmenu
```
